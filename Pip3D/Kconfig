## Pip3D/Kconfig
```kconfig
menu "Pip3D"

    config PIP3D_SCREEN_WIDTH
        int "Render width (pixels)"
        range 16 2048
        default 480
        help
            Logical framebuffer width. The panel driver sees the transposed
            resolution (height x width) because the engine renders in
            rotated space.

    config PIP3D_SCREEN_HEIGHT
        int "Render height (pixels)"
        range 16 2048
        default 320

    config PIP3D_SCREEN_BAND_COUNT
        int "Horizontal bands per frame"
        range 1 32
        default 8
        help
            The framebuffer is split into this many bands rendered and
            flushed one by one, trading CPU spikes for a small band buffer.

    config PIP3D_DISPLAY_ROTATION
        int "Panel rotation passed to PipCore (0-3)"
        range 0 3
        default 1

    config PIP3D_DISPLAY_ORDER
        int "Panel color order (0=RGB, 1=BGR)"
        range 0 1
        default 1

    config PIP3D_DISPLAY_INVERT
        bool "Invert panel colors"
        default y

    config PIP3D_DISPLAY_SWAP
        bool "Swap framebuffer bytes for the panel"
        default y
        help
            The engine framebuffer holds native (little-endian) RGB565
            pixels, while SPI panels take big-endian bytes. PipCore swaps
            on the way out only when this is set - the old vendored driver
            always swapped, so this must stay on.

    config PIP3D_SIMD
        bool "SIMD render paths (Xtensa S3 'ee' DSP instructions)"
        depends on IDF_TARGET_ESP32S3
        default y
        help
            Hand-written 'ee.*' DSP assembly for span fills and the sky
            gradient. Inflates IRAM (less free heap); scalar fallbacks
            cover every call site when disabled.

    menu "Debug"

        config PIP3D_ENABLE_LOGGING
            bool "Engine logging"
            default y

        config PIP3D_LOG_DEFAULT_LEVEL
            int "Engine log level (0=off ... 5=verbose)"
            range 0 5
            default 1
            depends on PIP3D_ENABLE_LOGGING

        config PIP3D_ENABLE_GIZMOS
            bool "Debug gizmos (lines, spheres, AABB)"
            default y

        config PIP3D_ENABLE_DRAW_TELEMETRY
            bool "Draw-call telemetry"
            default n

    endmenu

endmenu
```

## sdkconfig.defaults
```kconfig
CONFIG_ESP_DEFAULT_CPU_FREQ_MHZ_240=y
CONFIG_ESP_DEFAULT_CPU_FREQ_MHZ=240
CONFIG_PM_ENABLE=n

CONFIG_ESPTOOLPY_FLASHSIZE_16MB=y
CONFIG_ESPTOOLPY_FLASHMODE_QIO=y
CONFIG_ESPTOOLPY_FLASHFREQ_80M=y
CONFIG_SPIRAM=n

CONFIG_ESP32S3_INSTRUCTION_CACHE_32KB=y
CONFIG_ESP32S3_INSTRUCTION_CACHE_LINE_32B=y
CONFIG_ESP32S3_DATA_CACHE_32KB=y
CONFIG_ESP32S3_DATA_CACHE_LINE_64B=y
CONFIG_ESP_SYSTEM_ALLOW_RTC_FAST_MEM_AS_HEAP=y

CONFIG_COMPILER_OPTIMIZATION_PERF=y
CONFIG_BOOTLOADER_COMPILER_OPTIMIZATION_SIZE=y
CONFIG_COMPILER_CXX_EXCEPTIONS=n
CONFIG_COMPILER_CXX_RTTI=n
CONFIG_COMPILER_STACK_CHECK_MODE_NONE=y
CONFIG_COMPILER_OPTIMIZATION_ASSERTIONS_DISABLE=y
CONFIG_HAL_DEFAULT_ASSERTION_LEVEL=0
CONFIG_HEAP_POISONING_DISABLED=y
CONFIG_COMPILER_CONFIG_DUMP=n

CONFIG_LIBC_NEWLIB_NANO_FORMAT=y
CONFIG_LIBC_OPTIMIZED_STRING_FUNCS=y

CONFIG_FREERTOS_UNICORE=n
CONFIG_FREERTOS_NUMBER_OF_CORES=2
CONFIG_FREERTOS_HZ=1000
CONFIG_FREERTOS_OPTIMIZED_FUNCTIONS=y
CONFIG_FREERTOS_READY_NODES_IN_RAM=y

CONFIG_FREERTOS_ENABLE_BACKWARD_COMPATIBILITY=n
CONFIG_FREERTOS_USE_TRACE_FACILITY=n
CONFIG_FREERTOS_GENERATE_RUN_TIME_STATS=n
CONFIG_FREERTOS_PLACE_FUNCTIONS_INTO_FLASH=n
CONFIG_FREERTOS_PLACE_SNAPSHOT_FUNS_INTO_FLASH=n

CONFIG_ESP_MAIN_TASK_AFFINITY_CPU1=y
CONFIG_ESP_MAIN_TASK_STACK_SIZE=6144
CONFIG_ESP_TIMER_TASK_AFFINITY_CPU0=y
CONFIG_ESP_TIMER_TASK_STACK_SIZE=2048
CONFIG_FREERTOS_TIMER_TASK_STACK_DEPTH=2048
CONFIG_FREERTOS_IDLE_TASK_STACKSIZE=1024

CONFIG_ESP_TASK_WDT_CHECK_IDLE_TASK_CPU0=n
CONFIG_ESP_TASK_WDT_CHECK_IDLE_TASK_CPU1=n
CONFIG_ESP_SYSTEM_CHECK_INT_LEVEL_4=n

CONFIG_SPI_MASTER_ISR_IN_IRAM=y
CONFIG_SPI_SLAVE_ISR_IN_IRAM=n
CONFIG_GDMA_CTRL_FUNC_IN_IRAM=y
CONFIG_I2C_ISR_IN_IRAM=y

CONFIG_BT_ENABLED=n
CONFIG_ESP_WIFI_ENABLED=n
CONFIG_ESP_COEX_ENABLED=n
CONFIG_ETH_ENABLED=n
CONFIG_MBEDTLS_CERTIFICATE_BUNDLE=n

CONFIG_LOG_DEFAULT_LEVEL_WARN=y
CONFIG_BOOTLOADER_LOG_LEVEL_WARN=y
CONFIG_LOG_COLORS=n
CONFIG_ESP_ERR_TO_NAME_LOOKUP=n
```
